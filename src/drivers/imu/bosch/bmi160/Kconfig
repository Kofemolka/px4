## src/drivers/imu/bosch/bmi160/Kconfig
```kconfig
menuconfig DRIVERS_IMU_BOSCH_BMI160
	bool "bosch bmi160"
	default n
	---help---
		Enable support for bosch bmi160
```

## src/modules/navput_tunnel/Kconfig
```kconfig
menuconfig MODULES_NAVPUT_TUNNEL
	bool "navput_tunnel"
	default n
	select LIB_CDRSTREAM
	---help---
		Enable support for navput_tunnel, which streams navput/estimator
		uORB topics to the GCS as CDR-encoded MAVLink TUNNEL messages.
```

## src/modules/navputer/Kconfig
```kconfig
menuconfig MODULES_NAVPUTER
	bool "navputer"
	default n
	---help---
		Enable support for navputer
config NAVPUT_CALIBRATION_LIFECYCLE
	bool "Use Navputer lifecycle for sensor calibration"
	depends on MODULES_NAVPUTER
	default n
	---help---
		Make shared sensor calibration modules subscribe to
		Navputer-adjusted vehicle lifecycle topics.
```
